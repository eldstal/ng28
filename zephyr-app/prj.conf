## CMakeLists.txt
```
cmake_minimum_required(VERSION 3.20.0)

set(BOARD native_sim)
#set(CONF_FILE prj.conf)

find_package(Zephyr)

project(ng28)



target_sources(app PRIVATE 
                           # Drivers and such
                           src/display-sim.cpp

                           # "OS" logic
                           src/main.cpp
                           src/viewmanager.cpp

                           # Graphical views
                           src/view.cpp
                           src/view-home.cpp
                       )
```

## prj.conf
```kconfig
CONFIG_HEAP_MEM_POOL_SIZE=16384
CONFIG_PRINTK=y
CONFIG_LOG=y
CONFIG_CPP=y
CONFIG_NO_OPTIMIZATIONS=y
```

## boards/native_sim.conf
```kconfig
CONFIG_DISPLAY=y
CONFIG_SDL_DISPLAY=y
#CONFIG_SDL_DISPLAY_DEFAULT_PIXEL_FORMAT_MONO10=y
#CONFIG_SDL_DISPLAY_MONO_MSB_FIRST=n
#CONFIG_SDL_DISPLAY_MONO_VTILED=n
CONFIG_SDL_DISPLAY_DEFAULT_PIXEL_FORMAT_ARGB_8888=y
CONFIG_SDL_DISPLAY_ZOOM_PCT=500
CONFIG_SDL_DISPLAY_TRANSPARENCY_GRID_CELL_SIZE=8
CONFIG_SDL_DISPLAY_TRANSPARENCY_GRID_CELL_COLOR_1=0xcccccc
CONFIG_SDL_DISPLAY_TRANSPARENCY_GRID_CELL_COLOR_2=0xbbbbbb
CONFIG_SDL_DISPLAY_THREAD_PRIORITY=0
```

## boards/native_sim.overlay
```dts
&sdl_dc {
    status = "okay";
    width = <101>;
    height = <33>;
};
```

## src/main.cpp
```c
#include <zephyr/logging/log.h>
LOG_MODULE_REGISTER(ng28, LOG_LEVEL_INF);

#include <zephyr/kernel.h>

#include "viewmanager.hpp"
#include "display.hpp"

int main() {


    display_init();
    display_backlight(false);

    uint16_t w, h;
    display_size(w, h);

    vman_start();

    LOG_INF("OK, we're up!\n");
    while (true) {
        k_sleep(K_MSEC(1000));
    }




}
```

## src/config.hpp
```c
#pragma once

#define DISPLAY_DOUBLE_BUFFER 1
#define DISPLAY_FRAME_TIME_MS 100
```

## src/display-sim.cpp
```c
#include <zephyr/logging/log.h>
LOG_MODULE_REGISTER(display_sim, LOG_LEVEL_INF);

#include <zephyr/sys/printk.h>
#include <zephyr/kernel.h>
#include <zephyr/device.h>
#include <zephyr/drivers/display.h>

#include "config.hpp"
#include "display.hpp"

#define PX_FG ((uint32_t) 0xFF183747)
#define PX_BG ((uint32_t) 0xFFa1a595)       // Backlight off
#define PX_BL ((uint32_t) 0xFF8FF7FC)       // Backlight on

struct k_mutex framebuf_mutex;

uint32_t px_on = PX_FG;
uint32_t px_off = PX_BG;

const struct device *display_dev;
struct display_capabilities display_caps;

struct display_buffer_descriptor framebuf_desc;
uint32_t* framebuf;
bool framebuf_dirty;

static inline void sim_display_px(uint16_t x, uint16_t y, bool val) {

    size_t pos = display_caps.x_resolution * y + x;

    // Out of bounds
    if (pos >= framebuf_desc.buf_size/4) return;

    framebuf[pos] = val ? px_on : px_off;
}

inline void sim_display_push() {
    display_write(display_dev, 0, 0, &framebuf_desc, framebuf);
}

static inline void sim_display_backlight(bool enabled) {
    
    px_off = enabled ? PX_BL : PX_BG;
    
    for (size_t i=0; i < display_caps.x_resolution * display_caps.y_resolution; i++) {
        framebuf[i] = framebuf[i] == px_on ? px_on : px_off;
    }

    framebuf_dirty = true;
}

static int sim_display_setup() {

    display_dev = DEVICE_DT_GET(DT_CHOSEN(zephyr_display));

    if (!device_is_ready(display_dev)) {
        LOG_ERR("Device %s is not found/ready. Won't be displaying anything.", display_dev->name);
        return -1;
    }

    display_get_capabilities(display_dev, &display_caps);



    framebuf_desc.buf_size = display_caps.x_resolution * display_caps.y_resolution * 4;

    framebuf_desc.pitch = display_caps.x_resolution;
    framebuf_desc.width = display_caps.x_resolution;
    framebuf_desc.height = display_caps.y_resolution;
    framebuf_desc.frame_incomplete = false;

    k_mutex_init(&framebuf_mutex);

    k_mutex_lock(&framebuf_mutex, K_FOREVER); {

        LOG_INF("Framebuffer: %lu bytes", framebuf_desc.buf_size);
        framebuf = (uint32_t*) k_malloc(framebuf_desc.buf_size);

        if (!framebuf) {
            LOG_ERR("Failed to allocate framebuffer.");
            return -1;
        }

        sim_display_backlight(false);
        sim_display_push();
    }


    k_mutex_unlock(&framebuf_mutex);

    display_blanking_off(display_dev);


    return 0;

}


void sim_display_thread(void* d0, void* d1, void* d2) {

    while (true) {
        k_mutex_lock(&framebuf_mutex, K_FOREVER);
            if (framebuf_dirty) {
                sim_display_push();
                framebuf_dirty = false;
            }
        k_mutex_unlock(&framebuf_mutex);

        // TODO: Subtract the duration of this last iteration
        k_sleep(K_MSEC(DISPLAY_FRAME_TIME_MS));
    }
}

K_THREAD_DEFINE(sim_display_tid, 512,
               sim_display_thread, NULL, NULL, NULL,
               K_LOWEST_APPLICATION_THREAD_PRIO, 0, 0);

/*
 * Exposed interface
 */

void display_px(uint16_t x, uint16_t y, bool val) {
    k_mutex_lock(&framebuf_mutex, K_FOREVER);
        sim_display_px(x, y, val);
#if DISPLAY_DOUBLE_BUFFER!=1
        framebuf_dirty = true;
#endif
    k_mutex_unlock(&framebuf_mutex);
}

void display_fill(bool val) {
    k_mutex_lock(&framebuf_mutex, K_FOREVER);
        for (size_t x=0; x<display_caps.x_resolution; x++) {
            for (size_t y=0; y<display_caps.x_resolution; y++) {
                sim_display_px(x, y, val);
            }
        }

#if DISPLAY_DOUBLE_BUFFER!=1
        framebuf_dirty = true;
#endif
    k_mutex_unlock(&framebuf_mutex);
}

void display_flip() {
#if DISPLAY_DOUBLE_BUFFER==1
    k_mutex_lock(&framebuf_mutex, K_FOREVER);
        framebuf_dirty = true;
    k_mutex_unlock(&framebuf_mutex);
#endif
}

void display_backlight(bool enabled) {
    k_mutex_lock(&framebuf_mutex, K_FOREVER);
        sim_display_backlight(enabled);
    k_mutex_unlock(&framebuf_mutex);
}

void display_size(uint16_t& w, uint16_t& h) {
    w = display_caps.x_resolution;
    h = display_caps.y_resolution;
}

void display_init() {
    sim_display_setup();
    k_thread_start(sim_display_tid);
}
```

## src/display.hpp
```c
#pragma once

#include <stdint.h>

// Update a single pixel in the back buffer
void display_px(uint16_t x, uint16_t y, bool val);

// Set all pixels to the same value
void display_fill(bool val);

// If double buffering is disabled, this does nothing
void display_flip();

void display_backlight(bool enabled);

void display_size(uint16_t& w, uint16_t& h);

// Initialize display, start background task
void display_init();

// If initialized, stop the display (suspend background task, etc)
void display_suspend();

// Resume after suspend
void display_resume();
```

## src/view-home.cpp
```c
#include "view-home.hpp"

#include "display.hpp"

#define evkind ViewEvent::Kind
#define reskind ViewResponse::Kind

void HomeView::button(int btn, ViewResponse& resp) {
    resp.kind = reskind::NOP;
}

void HomeView::draw() {
    uint16_t w, h;
    display_size(w, h);

    display_fill(false);

    for (int x=0; x<w; x++) {
        display_px(x, 0, true);
        display_px(x, h-1, true);
    }

    for (int y=0; y<h; y++) {
        display_px(0,   y, true);
        display_px(w-1, y, true);
    }

    display_flip();
}

void HomeView::event(const ViewEvent& ev, ViewResponse& resp) {

    resp.kind = reskind::NOP;

    switch (ev.kind) {

        case evkind::TERMINATE:
            // This should never happen to the home view, but OK.
            return;

        case evkind::BTN_RELEASE:
            button(ev.btn, resp);
            break;

        case evkind::REDRAW:
            draw();
            break;
        
        default:
            break;
    }
}
```

## src/view-home.hpp
```c
#pragma once

#include "view.hpp"

class HomeView : public View {
    private:
    void button(int btn, ViewResponse& resp);
    void draw();

    public:
    virtual void event(const ViewEvent& ev, ViewResponse& resp);
};
```

## src/view.cpp
```c
#include "view.hpp"

View::~View() {

}
```

## src/view.hpp
```c
#pragma once

#include <cstddef>

class View;

struct ViewEvent {
    enum Kind {
        // Button down
        BTN_PRESS,
        BTN_RELEASE,

        // This is a helpful reminder that you've just regained
        // focus after someone else has been touching the screen.
        // Redraw your entire UI once, please.
        REDRAW,

        // If you receive this, you've been asked to terminate
        // your view. No matter what you return, your view will
        // be delete'd when you do.
        TERMINATE
    };

    Kind kind = REDRAW;

    int btn = -1;
};

struct ViewResponse {

    enum Kind {
        // No change, you stay active
        NOP,

        // Terminate yourself and return to the parent view
        // You'll get one last event of TERMINATE to do your cleanup.
        TERMINATE,

        // Terminate yourself and all parents, return to the home screen
        HOME,

        // Launch a child view. When it terminates, control will return to you.
        // use new to allocate the new view and return it in launch_view
        LAUNCH
    };

    Kind kind = NOP;

    // If you return action==LAUNCH
    // create a new view and return it here.
    // The manager will call delete on this when it terminates.
    View* launch_view = NULL;
};

class View {
    public:

    // TODO: What if you don't want an event driven view?
    // If we're making games, this probably won't be good enough.

    // TODO: What if you need refreshes every now and then? Like the clock on the home screen

    // You're the foreground view
    // Something happened
    // What do you do?
    virtual void event(const ViewEvent& ev, ViewResponse& resp) = 0;

    virtual ~View();

};
```

## src/viewmanager.cpp
```c
#include <zephyr/logging/log.h>
LOG_MODULE_REGISTER(viewmanager, LOG_LEVEL_INF);

#include <zephyr/kernel.h>
#include <zephyr/device.h>


#include "viewmanager.hpp"
#include "view.hpp"
#include "view-home.hpp"

#define evkind ViewEvent::Kind
#define reskind ViewResponse::Kind

struct ViewStackEntry {
    // NULL for the home screen, which cannot terminate.
    ViewStackEntry* parent;
    View* view;
};

ViewStackEntry* view_stack;

static void push_and_handle_event(const ViewEvent& ev);

static void send_terminate(View* view) {
                    
    ViewEvent terminate;
    terminate.kind = evkind::TERMINATE;

    ViewResponse ignored;
    ignored.kind = reskind::NOP;
    

    if (ignored.launch_view != NULL) {
        LOG_ERR("A view responded to a TERMINATE with some heap allocation. You've got a leak.");
    }
    view->event(terminate, ignored);

}

static void terminate_active_view() {
    if (view_stack->parent == NULL) {
        LOG_ERR("Tried to TERMINATE home view. Can't do that.\n");
    } else {
        send_terminate(view_stack->view);

        ViewStackEntry* old_head = view_stack;
        view_stack = old_head->parent;

        delete old_head->view;
        delete old_head;

        LOG_ERR("View terminated.");

    }
}

static void redraw_active_view() {
    // Make the reopened view perform a full draw
    ViewEvent redraw;
    redraw.kind = evkind::REDRAW;
    push_and_handle_event(redraw);
}


static void push_and_handle_event(const ViewEvent& ev) {
        ViewResponse resp;
        resp.kind = reskind::NOP;

        view_stack->view->event(ev, resp);

        switch (resp.kind) {
            case reskind::NOP:
                break;

            case reskind::TERMINATE:
                terminate_active_view();
                redraw_active_view();

                break;

            case reskind::HOME:
                while (view_stack->parent != NULL) {
                    terminate_active_view();
                }
                redraw_active_view();

                break;

            case reskind::LAUNCH:
                if(resp.launch_view == NULL) {
                    LOG_ERR("Tried to launch a NULL view. Don't do that.\n");
                } else {
                    ViewStackEntry* new_head = new ViewStackEntry();
                    new_head->parent = view_stack;
                    new_head->view = resp.launch_view;
                    view_stack = new_head;

                    LOG_ERR("View launched.");

                    redraw_active_view();

                }
                break;

        }


}

void vman_thread(void* d0, void* d1, void* d2) {

    while (true) {
        ViewEvent ev;
        ev.kind = evkind::REDRAW;

        push_and_handle_event(ev);

        k_sleep(K_MSEC(100));
    }
}

K_THREAD_DEFINE(vman_tid, 1024,
               vman_thread, NULL, NULL, NULL,
               K_LOWEST_APPLICATION_THREAD_PRIO, 0, 0);


void vman_start() {

    HomeView* home = new HomeView();

    ViewStackEntry* head = new ViewStackEntry();
    head->parent = NULL;
    head->view = home;

    view_stack = head;

    k_thread_start(vman_tid);
}
```

## src/viewmanager.hpp
```c
#pragma once

/*
 * The view manager is the glue between visible views
 * It will run your view (e.g. a menu) until it needs to
 * either quit (go back to the previous view) or launch
 * a new view (start the snake game).
 *
 * The view manager maintains a stack of views, e.g.
 *   0 home view, which launched
 *   1 main menu view, which launched
 *   2 settings menu view, which launched
 *   3 system info view
 *
 *  When a view terminates, the previous view in the
 *  stack resumes where it was.
 */

// Start the view manager and show the home screen
void vman_start();
```
